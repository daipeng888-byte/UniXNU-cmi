/*
 * cmi 面板：qcom,mdss_dsi_j2_p2_1_38_0c_0a_dsc_cmd
 *
 * 来源：目标设备 /sys/firmware/fdt（合并后的 DT），经 tools/fdt2dts.py 转换。
 * 由 TWRP 的 chosen/bootargs 确认 bootloader 选择：
 *   msm_drm.dsi_display0=qcom,mdss_dsi_j2_p2_1_38_0c_0a_dsc_cmd:
 *
 * 内容包含 qcom,mdss-dsi-on-command 等 DCS 初始化序列，逐字节来自设备，
 * 未经手写或改写。
 *
 * 待接入：本片段需要挂在 mdss_mdp@ae00000 之下；sm8250.dtsi 目前还没有
 * mdss 节点，接入前此文件不能参与编译。
 */

				qcom,mdss_dsi_j2_p2_1_38_0c_0a_dsc_cmd {
					qcom,mdss-dsi-panel-name = "xiaomi 38 0c 0a cmd mode dsc dsi panel";
					qcom,mdss-dsi-panel-type = "dsi_cmd_mode";
					qcom,mdss-dsi-virtual-channel-id = <0x0>;
					qcom,mdss-dsi-stream = <0x0>;
					qcom,mdss-dsi-bpp = <0x18>;
					qcom,mdss-dsi-color-order = "rgb_swap_rgb";
					qcom,mdss-dsi-underflow-color = <0xff>;
					qcom,mdss-dsi-border-color = <0x0>;
					qcom,dsi-ctrl-num = <0x0>;
					qcom,dsi-phy-num = <0x0>;
					qcom,mdss-dsi-traffic-mode = "burst_mode";
					qcom,mdss-dsi-lane-map = "lane_map_0123";
					qcom,mdss-dsi-bllp-eof-power-mode;
					qcom,mdss-dsi-bllp-power-mode;
					qcom,mdss-dsi-lane-0-state;
					qcom,mdss-dsi-lane-1-state;
					qcom,mdss-dsi-lane-2-state;
					qcom,mdss-dsi-lane-3-state;
					qcom,mdss-dsi-dma-trigger = "trigger_sw";
					qcom,mdss-dsi-mdp-trigger = "none";
					qcom,mdss-dsi-reset-sequence = <0x0 0x1 0x1 0x6>;
					qcom,mdss-pan-physical-width-dimension = <0x2c6>;
					qcom,mdss-pan-physical-height-dimension = <0x601>;
					qcom,mdss-dsi-te-pin-select = <0x1>;
					qcom,mdss-dsi-wr-mem-start = <0x2c>;
					qcom,mdss-dsi-wr-mem-continue = <0x3c>;
					qcom,mdss-dsi-te-dcs-command = <0x1>;
					qcom,mdss-dsi-te-check-enable;
					qcom,mdss-dsi-te-using-te-pin;
					qcom,mdss-dsi-tx-eot-append;
					qcom,mdss-dsi-lp11-init;
					qcom,mdss-dsi-panel-hdr-enabled;
					qcom,mdss-dsi-panel-hdr-color-primaries = <0x38a4 0x3c8c 0x7d00 0x4268 0x3c8c 0x7530 0x1f40 0xbb8>;
					qcom,mdss-dsi-panel-peak-brightness = <0x401640>;
					qcom,mdss-dsi-panel-blackness-level = <0xc9e>;
					qcom,bl-update-flag = "delay_until_first_frame";
					mi,panel-id = <0x4a32 0x380c00>;
					mi,feature-enabled;
					mi,mdss-dsi-bl-dcs-big-endian-type;
					mi,mdss-dsi-panel-disp-rate-gpio = <0x65 0x32 0x0>;
					mi,esd-err-irq-gpio = <0x65 0x33 0x2001>;
					mi,mdss-dsi-panel-gamma-update-flag;
					mi,mdss-dsi-panel-gamma-flash-read-total-param = <0x1c4>;
					mi,mdss-dsi-panel-gamma-flash-read-c1-index = <0x8>;
					mi,mdss-dsi-panel-gamma-update-c8-index = <0x2>;
					mi,mdss-dsi-panel-gamma-update-c9-index = <0x3>;
					mi,mdss-dsi-panel-gamma-update-b3-index = <0x5>;
					mi,mdss-dsi-panel-gamma-black-setting-flag;
					mi,mdss-dsi-panel-hbm-51-ctrl-flag;
					mi,mdss-dsi-panel-hbm-off-51-index = <0x4>;
					mi,mdss-dsi-panel-fod-off-51-index = <0x5>;
					mi,mdss-dsi-white-point-read-enabled;
					mi,mdss-dsi-white-point-register-read-length = <0x13>;
					mi,mdss-dsi-white-point-info-index = <0xd>;
					mi,mdss-dsi-white-point-info-length = <0x6>;
					mi,mdss-dsi-panel-dc-threshold = <0x1b8>;
					mi,mdss-dsi-panel-dc-type = <0x1>;
					mi,mdss-panel-on-dimming-delay = <0x78>;
					mi,mdss-dsi-panel-fod-dimlayer-enabled;
					mi,mdss-panel-delay-before-fod-hbm-on;
					mi,mdss-panel-delay-before-fod-hbm-off;
					mi,mdss-panel-fod-skip-nolp;
					mi,mdss-dsi-dimlayer-brightness-alpha-lut-item-count = <0x15>;
					mi,mdss-dsi-dimlayer-brightness-alpha-lut = <0x0 0xff 0x4 0xeb 0x8 0xea 0xc 0xe9 0xd 0xe8 0x14 0xe5 0x18 0xe3 0x1e 0xe0 0x44 0xd0 0x85 0xc0 0xda 0xb0 0x148 0xa0 0x1e6 0x90 0x282 0x80 0x340 0x70 0x413 0x60 0x4f3 0x50 0x5dc 0x40 0x6ea 0x30 0x7d0 0x24 0x7ff 0x21>;
					qcom,ulps-enabled;
					qcom,dsi-select-clocks = "mux_byte_clk0", "mux_pixel_clk0", "src_byte_clk0", "src_pixel_clk0", "shadow_byte_clk0", "shadow_pixel_clk0";
					qcom,mdss-dsi-clk-strength = <0xff>;
					qcom,panel-supply-entries = <0x667>;
					qcom,mdss-dsi-bl-pmic-control-type = "bl_ctrl_dcs";
					qcom,mdss-dsi-bl-min-level = <0x2>;
					qcom,mdss-dsi-bl-max-level = <0x7ff>;
					qcom,mdss-brightness-max-level = <0x7ff>;
					qcom,mdss-brightness-init-level = <0x133>;
					qcom,platform-te-gpio = <0x65 0x42 0x0>;
					qcom,platform-reset-gpio = <0x65 0xc 0x0>;
					phandle = <0x67d>;
					qcom,mdss-dsi-display-timings {
						timing@0 {
							qcom,mdss-dsi-panel-framerate = <0x3c>;
							qcom,mdss-dsi-panel-width = <0x438>;
							qcom,mdss-dsi-panel-height = <0x924>;
							qcom,mdss-dsi-h-front-porch = <0x10>;
							qcom,mdss-dsi-h-back-porch = <0x8>;
							qcom,mdss-dsi-h-pulse-width = <0x8>;
							qcom,mdss-dsi-h-sync-skew = <0x0>;
							qcom,mdss-dsi-v-back-porch = <0x230>;
							qcom,mdss-dsi-v-front-porch = <0x258>;
							qcom,mdss-dsi-v-pulse-width = <0x20>;
							qcom,mdss-dsi-h-sync-pulse = <0x0>;
							qcom,mdss-dsi-h-left-border = <0x0>;
							qcom,mdss-dsi-h-right-border = <0x0>;
							qcom,mdss-dsi-v-top-border = <0x0>;
							qcom,mdss-dsi-v-bottom-border = <0x0>;
							qcom,mdss-dsi-panel-clockrate = <0x28a67e80>;
							qcom,mdss-dsi-panel-jitter = <0x5 0x1>;
							qcom,mdss-mdp-transfer-time-us = <0x251c>;
							qcom,mdss-dsi-on-command = <0x7010000 0x101 0x39010000 0x5a0a 0x11000089 0x30800924 0x4380041 0x21c021c 0x200020e 0x200650 0x7000c 0x1800191 0x180010f0 0x30c2000 0x60b0b33 0xe1c2a38 0x46546269 0x7077797b 0x7d7e0102 0x1000940 0x9be19fc 0x19fa19f8 0x1a381a78 0x1ab62af6 0x2b342b74 0x3b746bf4 0x50100 0xa0002 0x11003901 0x0 0x3f05a5a 0x39010000 0x2b0 0x40390100 0x4 0xcbda9ada 0x39010000 0x3f0 0xa5a51501 0x0 0x2532015 0x1000000 0x23500 0x39010000 0x52a 0x437 0x39010000 0x52b 0x923 0x39010000 0x3f0 0x5a5a3901 0x0 0xab90000 0x14180000 0x110339 0x1000000 0x3f0a5 0xa5390100 0x3 0xf05a5a39 0x1000000 0x3ed04 0x1390100 0x3 0xf0a5a539 0x1000000 0x3fc5a 0x5a150100 0x2 0xb0861501 0x0 0x2eb0139 0x100003c 0x3fca5 0xa5390100 0x3 0xf05a5a39 0x1000000 0x3b034 0xb1150100 0x2 0xb15d1501 0x0 0x2b00515 0x1000000 0x2b120 0x15010000 0x2b0 0x2150100 0x2 0xb5d31501 0x0 0x2532039 0x1000000 0x35100 0x390100 0x3 0xf0a5a505 0x1000000 0x22900>;
							qcom,mdss-dsi-off-command = [05 01 00 00 0a 00 02 28 00 15 01 00 00 00 00 02 53 20 05 01 00 00 78 00 02 10 00];
							qcom,mdss-dsi-on-command-state = "dsi_lp_mode";
							qcom,mdss-dsi-off-command-state = "dsi_lp_mode";
							qcom,mdss-dsi-timing-switch-command = <0x39010000 0x3f0 0x5a5a1501 0x0 0x2532039 0x1000000 0x88c8aa 0xaa95a68d 0xde655297 0x21124dc1 0xb9e75555 0x41807aa1 0x5753752d 0x3146f3ff 0x5000000 0xcfe9de8f 0xce990000 0x0 0xaaaa956c 0x6ba16c6b 0xa122134f 0xc1b9e855 0x55457f7a 0xa2575477 0x2d334af4 0x80d0000 0xc4fae8 0x9ae7b500 0x0 0xaaaa95 0x6c6ba16c 0x6ba12112 0x4ec1bae9 0x55554580 0x7da4585a 0x7a2e3b4b 0xf6181310 0x4000d30e 0xf7b902d3 0x0 0x3901 0x0 0xb5c9aaaa 0x956c6ba1 0x6c6ba11f 0x104bbfb9 0xe8555545 0x7e7fa356 0x5d7b2c40 0x4ff62618 0x144000da 0x1c02c213 0xe4000000 0xaa 0xaa956c6b 0xa16c6ba1 0x1a0c47bd 0xb8e65555 0x457c7fa2 0x55617b2d 0x4752fb31 0x20144000 0xe62a0cd4 0x20f50000 0x0 0xaaaa956c 0x6ba16c6b 0xa11c0e4a 0xbfbfea55 0x5555808a 0xa95a7082 0x345d5f0b 0x4a341450 0xfa4323 0xe6342000 0x0 0xaaa595 0x6c6ba16c 0x6ba1f7f0 0x25a8b0d3 0x5555556f 0x889a4e76 0x7b2f695c 0x175e3f54 0x50000856 0x32fb5829 0x0 0x1501 0x0 0x2b00239 0x1000000 0x2eb3ae 0xaa96d6b7 0x118e79c2 0x43c24331 0x71d9cf01 0x55554592 0x8bb56761 0x873b3b56 0xfb021000 0xd9ee 0xed010101 0x0 0x15010000 0x2b0 0x5150100 0x2 0xb1203901 0x0 0x3f0a5a5>;
							qcom,mdss-dsi-timing-switch-command-state = "dsi_hs_mode";
							qcom,mdss-dsi-nolp-command = [05 01 00 00 00 00 02 28 00 39 01 00 00 00 00 03 f0 5a 5a 15 01 00 00 00 00 02 53 28 39 01 00 00 22 00 03 f0 a5 a5 05 01 00 00 00 00 02 29 00];
							qcom,mdss-dsi-nolp-command-state = "dsi_hs_mode";
							qcom,compression-mode = "dsc";
							qcom,mdss-dsc-slice-height = <0x41>;
							qcom,mdss-dsc-slice-width = <0x21c>;
							qcom,mdss-dsc-slice-per-pkt = <0x2>;
							qcom,mdss-dsc-bit-per-component = <0x8>;
							qcom,mdss-dsc-bit-per-pixel = <0x8>;
							qcom,mdss-dsc-block-prediction-enable;
							mi,mdss-dsi-doze-hbm-command = [05 01 00 00 22 00 02 28 00 39 01 00 00 00 00 03 f0 5a 5a 15 01 00 00 00 00 02 53 22 39 01 00 00 00 00 03 f0 a5 a5 05 01 00 00 00 00 02 29 00];
							mi,mdss-dsi-doze-lbm-command = [05 01 00 00 22 00 02 28 00 39 01 00 00 00 00 03 f0 5a 5a 15 01 00 00 00 00 02 53 23 39 01 00 00 00 00 03 f0 a5 a5 05 01 00 00 00 00 02 29 00];
							mi,mdss-dsi-doze-hbm-command-state = "dsi_hs_mode";
							mi,mdss-dsi-doze-lbm-command-state = "dsi_hs_mode";
							mi,mdss-dsi-hbm-on-command = [39 00 00 00 00 00 03 f0 5a 5a 39 00 00 00 00 00 02 b0 02 39 00 00 00 00 00 02 b5 53 39 00 00 00 00 00 02 c7 27 39 00 00 00 00 00 02 b0 34 39 00 00 00 00 00 02 b1 4b 39 00 00 00 00 00 02 b0 06 39 00 00 00 00 00 20 b1 00 00 00 0f 03 e1 02 0a 14 1e 33 66 00 ff 00 00 00 00 00 00 02 0a 14 1e 33 47 66 85 a4 c2 e1 39 00 00 00 00 00 02 b0 03 39 00 00 00 00 00 1b b5 14 14 14 14 14 14 14 14 14 14 14 14 14 14 14 14 14 14 14 14 14 14 14 14 14 14 39 00 00 00 00 00 02 b0 17 39 00 00 00 00 00 02 95 30 39 01 00 00 11 00 03 f0 a5 a5 15 01 00 00 00 00 02 53 e8 39 01 00 00 11 00 03 51 0f ff];
							mi,mdss-dsi-hbm-off-command = [39 00 00 00 00 00 03 f0 5a 5a 39 00 00 00 00 00 02 b0 02 39 00 00 00 00 00 02 b5 53 39 01 00 00 00 00 03 f0 a5 a5 39 01 00 00 00 00 03 51 03 ff 39 00 00 00 00 00 03 f0 5a 5a 39 00 00 00 00 00 02 c7 23 39 00 00 00 00 00 02 b0 34 39 00 00 00 00 00 02 b1 5d 39 00 00 00 00 00 02 b0 06 39 00 00 00 00 00 20 b1 30 00 00 16 0f 85 08 29 52 7b cd 9a 65 ff 00 00 01 12 23 30 08 29 52 7b cd 1f 9a 15 90 0a 85 39 00 00 00 00 00 02 b0 03 39 00 00 00 00 00 1b b5 50 50 50 50 50 50 50 50 50 50 50 50 50 50 50 50 50 50 50 50 50 50 50 50 50 50 39 00 00 00 00 00 02 b0 17 39 00 00 00 00 00 02 95 00 39 01 00 00 00 00 03 f0 a5 a5 15 01 00 00 00 00 02 53 28];
							mi,mdss-dsi-hbm-on-command-state = "dsi_hs_mode";
							mi,mdss-dsi-hbm-off-command-state = "dsi_hs_mode";
							mi,mdss-dsi-hbm-fod-on-command = [39 00 00 00 00 00 03 f0 5a 5a 39 00 00 00 00 00 02 b0 02 39 00 00 00 00 00 02 b5 93 39 01 00 00 07 00 03 f0 a5 a5 15 01 00 00 11 00 02 53 e0 39 00 00 00 00 00 03 51 0d ff 39 00 00 00 00 00 03 f0 5a 5a 39 00 00 00 00 00 02 c7 27 39 00 00 00 00 00 02 b0 34 39 00 00 00 00 00 02 b1 4b 39 00 00 00 00 00 02 b0 06 39 00 00 00 00 00 20 b1 00 00 00 0f 03 e1 02 0a 14 1e 33 66 00 ff 00 00 00 00 00 00 02 0a 14 1e 33 47 66 85 a4 c2 e1 39 00 00 00 00 00 02 b0 03 39 00 00 00 00 00 1b b5 14 14 14 14 14 14 14 14 14 14 14 14 14 14 14 14 14 14 14 14 14 14 14 14 14 14 39 00 00 00 00 00 02 b0 17 39 00 00 00 00 00 02 95 30 39 01 00 00 00 00 03 f0 a5 a5];
							mi,mdss-dsi-hbm-fod-off-command = [39 00 00 00 00 00 03 f0 5a 5a 39 00 00 00 00 00 02 b0 02 39 00 00 00 00 00 02 b5 13 39 01 00 00 07 00 03 f0 a5 a5 15 00 00 00 00 00 02 53 20 39 01 00 00 11 00 03 51 03 ff 39 00 00 00 00 00 03 f0 5a 5a 39 00 00 00 00 00 02 c7 23 39 00 00 00 00 00 02 b0 34 39 00 00 00 00 00 02 b1 5d 39 00 00 00 00 00 02 b0 06 39 00 00 00 00 00 20 b1 30 00 00 16 0f 85 08 29 52 7b cd 9a 65 ff 00 00 01 12 23 30 08 29 52 7b cd 1f 9a 15 90 0a 85 39 00 00 00 00 00 02 b0 03 39 00 00 00 00 00 1b b5 50 50 50 50 50 50 50 50 50 50 50 50 50 50 50 50 50 50 50 50 50 50 50 50 50 50 39 00 00 00 00 00 02 b0 17 39 00 00 00 00 00 02 95 00 39 01 00 00 00 00 03 f0 a5 a5];
							mi,mdss-dsi-hbm-fod-on-command-state = "dsi_hs_mode";
							mi,mdss-dsi-hbm-fod-off-command-state = "dsi_hs_mode";
							mi,mdss-dsi-flat-on-command = [39 00 00 00 00 00 03 f0 5a 5a 39 00 00 00 00 00 1d 95 2e 2d 09 09 09 24 24 24 30 30 30 39 39 39 3c 3c 3c 3d 42 7c c7 55 c0 43 1b e0 2f 48 39 00 00 00 00 00 02 f7 06 39 01 00 00 00 00 03 f0 a5 a5];
							mi,mdss-dsi-flat-off-command = [39 00 00 00 00 00 03 f0 5a 5a 39 00 00 00 00 00 1d 95 2e 0d 09 09 09 24 24 24 30 30 30 39 39 39 3c 3c 3c 3d 42 7c c7 55 c0 43 1b e0 2f 48 39 00 00 00 00 00 02 f7 06 39 01 00 00 00 00 03 f0 a5 a5];
							mi,mdss-dsi-flat-on-command-state = "dsi_hs_mode";
							mi,mdss-dsi-flat-off-command-state = "dsi_hs_mode";
							mi,mdss-dsi-hbm-hdr-on-command = [39 00 00 00 00 00 03 f0 5a 5a 39 00 00 00 00 00 02 b0 02 39 00 00 00 00 00 02 b5 53 39 00 00 00 00 00 02 c7 27 39 00 00 00 00 00 02 b0 34 39 00 00 00 00 00 02 b1 4b 39 00 00 00 00 00 02 b0 06 39 00 00 00 00 00 20 b1 00 00 00 0f 03 e1 02 0a 14 1e 33 66 00 ff 00 00 00 00 00 00 02 0a 14 1e 33 47 66 85 a4 c2 e1 39 00 00 00 00 00 02 b0 03 39 00 00 00 00 00 1b b5 14 14 14 14 14 14 14 14 14 14 14 14 14 14 14 14 14 14 14 14 14 14 14 14 14 14 39 00 00 00 00 00 02 b0 17 39 00 00 00 00 00 02 95 30 39 01 00 00 11 00 03 f0 a5 a5 15 01 00 00 00 00 02 53 e8 39 01 00 00 11 00 03 51 0f ff];
							mi,mdss-dsi-hbm-hdr-off-command = [39 00 00 00 00 00 03 f0 5a 5a 39 00 00 00 00 00 02 b0 02 39 00 00 00 00 00 02 b5 53 39 01 00 00 00 00 03 f0 a5 a5 39 01 00 00 00 00 03 51 03 ff 39 00 00 00 00 00 03 f0 5a 5a 39 00 00 00 00 00 02 c7 23 39 00 00 00 00 00 02 b0 34 39 00 00 00 00 00 02 b1 5d 39 00 00 00 00 00 02 b0 06 39 00 00 00 00 00 20 b1 30 00 00 16 0f 85 08 29 52 7b cd 9a 65 ff 00 00 01 12 23 30 08 29 52 7b cd 1f 9a 15 90 0a 85 39 00 00 00 00 00 02 b0 03 39 00 00 00 00 00 1b b5 50 50 50 50 50 50 50 50 50 50 50 50 50 50 50 50 50 50 50 50 50 50 50 50 50 50 39 00 00 00 00 00 02 b0 17 39 00 00 00 00 00 02 95 00 39 01 00 00 00 00 03 f0 a5 a5 15 01 00 00 00 00 02 53 28];
							mi,mdss-dsi-hbm-hdr-on-command-state = "dsi_hs_mode";
							mi,mdss-dsi-hbm-hdr-off-command-state = "dsi_hs_mode";
							mi,mdss-dsi-dimmingon-command = [15 01 00 00 00 00 02 53 28];
							mi,mdss-dsi-dimmingon-command-state = "dsi_hs_mode";
							mi,mdss-dsi-dimmingoff-command = [15 01 00 00 00 00 02 53 20];
							mi,mdss-dsi-dimmingoff-command-state = "dsi_hs_mode";
							mi,mdss-dsi-level2-key-enable-command = [39 01 00 00 00 00 03 f0 5a 5a];
							mi,mdss-dsi-gamma-otp-read-c8-command = [06 01 00 00 00 00 02 c8 00];
							mi,mdss-dsi-gamma-otp-read-c9-command = [06 01 00 00 00 00 02 c9 00];
							mi,mdss-dsi-gamma-otp-read-b3-pre-command = [15 01 00 00 00 00 02 b0 02];
							mi,mdss-dsi-gamma-otp-read-b3-command = [06 01 00 00 00 00 02 b3 00];
							mi,mdss-dsi-level2-key-disable-command = [39 01 00 00 00 00 03 f0 a5 a5];
							mi,mdss-dsi-gamma-flash-read-pre-command = <0x39000000 0x3f0 0x5a5a3900 0x0 0x3f1f1a2 0x39000000 0xdc1 0x6 0x0 0x5 0x15000000 0x2c0 0x3390000 0xc 0xc1000000 0x1400200 0x10 0x15000000 0x2c0 0x3390000 0xe 0xc1000000 0x6b000000 0xa000000 0x5011500 0x0 0x2b00739 0x0 0x4c107 0x1500 0x0 0x2c00315 0x1000000 0x2b00b>;
							mi,mdss-dsi-gamma-read-fb-command = [06 01 00 00 00 00 02 fb 00];
							mi,mdss-dsi-level2-key-enable-command-state = "dsi_lp_mode";
							mi,mdss-dsi-gamma-otp-read-c8-command-state = "dsi_lp_mode";
							mi,mdss-dsi-gamma-otp-read-c9-command-state = "dsi_lp_mode";
							mi,mdss-dsi-gamma-otp-read-b3-pre-command-state = "dsi_lp_mode";
							mi,mdss-dsi-gamma-otp-read-b3-command-state = "dsi_lp_mode";
							mi,mdss-dsi-level2-key-disable-command-state = "dsi_lp_mode";
							mi,mdss-dsi-gamma-flash-read-pre-command-state = "dsi_lp_mode";
							mi,mdss-dsi-gamma-read-fb-command-state = "dsi_lp_mode";
							mi,mdss-dsi-white-point-read-command = [06 01 00 00 01 00 02 a1 00];
							mi,mdss-dsi-white-point-read-command-state = "dsi_lp_mode";
							mi,mdss-dsi-crc-off-command = [39 01 00 00 00 00 02 81 00 39 00 00 00 00 00 03 f0 5a 5a 39 00 00 00 00 00 02 67 01 39 01 00 00 00 00 03 f0 a5 a5];
							mi,mdss-dsi-crc-off-command-state = "dsi_hs_mode";
							mi,mdss-dsi-black-setting-command = [39 00 00 00 00 00 03 f0 5a 5a 39 00 00 00 00 00 03 b0 29 b3 39 00 00 00 00 00 04 b3 00 00 00 39 00 00 00 00 00 03 b0 2e bb 39 00 00 00 00 00 04 bb 00 00 00 39 00 00 00 00 00 03 b0 25 b1 39 00 00 00 00 00 10 b1 98 88 76 54 32 04 dc 6a 0d 42 95 30 6a 3e 2a 39 01 00 00 00 00 03 f0 a5 a5];
							mi,mdss-dsi-black-setting-command-state = "dsi_hs_mode";
							qcom,mdss-dsi-panel-phy-timings = [00 18 06 06 21 20 06 06 04 02 04 00 15 16];
							qcom,display-topology = <0x1 0x1 0x1>;
							qcom,default-topology-index = <0x0>;
						};
						timing@1 {
							qcom,mdss-dsi-panel-framerate = <0x5a>;
							qcom,mdss-dsi-panel-width = <0x438>;
							qcom,mdss-dsi-panel-height = <0x924>;
							qcom,mdss-dsi-h-front-porch = <0x10>;
							qcom,mdss-dsi-h-back-porch = <0x8>;
							qcom,mdss-dsi-h-pulse-width = <0x8>;
							qcom,mdss-dsi-h-sync-skew = <0x0>;
							qcom,mdss-dsi-v-back-porch = <0x8>;
							qcom,mdss-dsi-v-front-porch = <0x4>;
							qcom,mdss-dsi-v-pulse-width = <0x4>;
							qcom,mdss-dsi-h-sync-pulse = <0x0>;
							qcom,mdss-dsi-h-left-border = <0x0>;
							qcom,mdss-dsi-h-right-border = <0x0>;
							qcom,mdss-dsi-v-top-border = <0x0>;
							qcom,mdss-dsi-v-bottom-border = <0x0>;
							qcom,mdss-dsi-panel-clockrate = <0x28a67e80>;
							qcom,mdss-dsi-panel-jitter = <0x5 0x1>;
							qcom,mdss-mdp-transfer-time-us = <0x251c>;
							qcom,mdss-dsi-on-command = <0x7010000 0x101 0x39010000 0x5a0a 0x11000089 0x30800924 0x4380041 0x21c021c 0x200020e 0x200650 0x7000c 0x1800191 0x180010f0 0x30c2000 0x60b0b33 0xe1c2a38 0x46546269 0x7077797b 0x7d7e0102 0x1000940 0x9be19fc 0x19fa19f8 0x1a381a78 0x1ab62af6 0x2b342b74 0x3b746bf4 0x50100 0xa0002 0x11003901 0x0 0x3f05a5a 0x39010000 0x2b0 0x40390100 0x4 0xcbda9ada 0x39010000 0x3f0 0xa5a51501 0x0 0x2532015 0x1000000 0x23500 0x39010000 0x52a 0x437 0x39010000 0x52b 0x923 0x39010000 0x3f0 0x5a5a3901 0x0 0xab90000 0x14180000 0x110339 0x1000000 0x3f0a5 0xa5390100 0x3 0xf05a5a39 0x1000000 0x3ed04 0x1390100 0x3 0xf0a5a539 0x1000000 0x3fc5a 0x5a150100 0x2 0xb0861501 0x0 0x2eb0139 0x100003c 0x3fca5 0xa5390100 0x3 0xf05a5a39 0x1000000 0x3b034 0xb1150100 0x2 0xb15d1501 0x0 0x2b00515 0x1000000 0x2b110 0x15010000 0x2b0 0x2150100 0x2 0xb5d31501 0x0 0x2533039 0x1000000 0x35100 0x390100 0x3 0xf0a5a505 0x1000000 0x22900>;
							qcom,mdss-dsi-off-command = [05 01 00 00 0a 00 02 28 00 15 01 00 00 00 00 02 53 20 05 01 00 00 78 00 02 10 00];
							qcom,mdss-dsi-on-command-state = "dsi_lp_mode";
							qcom,mdss-dsi-off-command-state = "dsi_lp_mode";
							qcom,mdss-dsi-timing-switch-command = <0x39010000 0x3f0 0x5a5a1501 0x0 0x2533039 0x1000000 0x88c8aa 0xaa95a58c 0xdd655297 0x21124dc1 0xb9e75555 0x45807ba1 0x5854762f 0x3447f807 0x9000000 0xd7f6e6a8 0xe3af0000 0x0 0xaaaa956c 0x6ba16c6b 0xa122134f 0xc1b9e855 0x5545817c 0xa3595879 0x303a4cfb 0x17111040 0xdb0ef6 0xc703d200 0x0 0xaaaa95 0x6c6ba16c 0x6ba12111 0x4dc1bbe9 0x55555582 0x80a55a5f 0x7b354553 0x62d1f14 0x4000f327 0xde918f3 0x0 0x3901 0x0 0xb5c9aaaa 0x956c6ba1 0x6c6ba11e 0x104bc0bc 0xe8555555 0x8184a55c 0x667d3650 0x560d3e28 0x54500003 0x371afa32 0xa000000 0xaa 0xaa956c6b 0xa16c6ba1 0x1b0c47bd 0xbbe65555 0x558089a5 0x5c6b7e3a 0x595b174a 0x33555000 0x10462606 0x3e170000 0x0 0xaaaa956c 0x6ba16c6b 0xa11c0f4a 0xc1c4eb55 0x55558597 0xad65838b 0x48746c32 0x674f5550 0x2d6444 0x20374200 0x0 0xaaa595 0x6c6ba16c 0x6ba1f9f5 0x26acb9d6 0x5555557b 0x9aa1638e 0x88518572 0x437d5e55 0x50003e79 0x57315962 0x0 0x1501 0x0 0x2b00239 0x1000000 0x2eb3ae 0xaa96d6b7 0x118d78c1 0x423070d9 0xcf015555 0x45928bb5 0x6762873c 0x3d57fe09 0x11000000 0xe1faf301 0x1010000 0x0 0x15010000 0x2b0 0x5150100 0x2 0xb1103901 0x0 0x3f0a5a5>;
							qcom,mdss-dsi-timing-switch-command-state = "dsi_hs_mode";
							qcom,mdss-dsi-nolp-command = [05 01 00 00 00 00 02 28 00 39 01 00 00 00 00 03 f0 5a 5a 15 01 00 00 00 00 02 53 38 39 01 00 00 17 00 03 f0 a5 a5 05 01 00 00 00 00 02 29 00];
							qcom,mdss-dsi-nolp-command-state = "dsi_hs_mode";
							qcom,compression-mode = "dsc";
							qcom,mdss-dsc-slice-height = <0x41>;
							qcom,mdss-dsc-slice-width = <0x21c>;
							qcom,mdss-dsc-slice-per-pkt = <0x2>;
							qcom,mdss-dsc-bit-per-component = <0x8>;
							qcom,mdss-dsc-bit-per-pixel = <0x8>;
							qcom,mdss-dsc-block-prediction-enable;
							mi,mdss-dsi-doze-hbm-command = [05 01 00 00 17 00 02 28 00 39 01 00 00 00 00 03 f0 5a 5a 15 01 00 00 00 00 02 53 22 39 01 00 00 00 00 03 f0 a5 a5 05 01 00 00 00 00 02 29 00];
							mi,mdss-dsi-doze-lbm-command = [05 01 00 00 17 00 02 28 00 39 01 00 00 00 00 03 f0 5a 5a 15 01 00 00 00 00 02 53 23 39 01 00 00 00 00 03 f0 a5 a5 05 01 00 00 00 00 02 29 00];
							mi,mdss-dsi-doze-hbm-command-state = "dsi_hs_mode";
							mi,mdss-dsi-doze-lbm-command-state = "dsi_hs_mode";
							mi,mdss-dsi-hbm-on-command = [39 00 00 00 00 00 03 f0 5a 5a 39 00 00 00 00 00 02 b0 02 39 00 00 00 00 00 02 b5 53 39 00 00 00 00 00 02 c7 27 39 00 00 00 00 00 02 b0 34 39 00 00 00 00 00 02 b1 4b 39 00 00 00 00 00 02 b0 06 39 00 00 00 00 00 20 b1 00 00 00 0f 03 e1 02 0a 14 1e 33 66 00 ff 00 00 00 00 00 00 02 0a 14 1e 33 47 66 85 a4 c2 e1 39 00 00 00 00 00 02 b0 03 39 00 00 00 00 00 1b b5 14 14 14 14 14 14 14 14 14 14 14 14 14 14 14 14 14 14 14 14 14 14 14 14 14 14 39 00 00 00 00 00 02 b0 17 39 00 00 00 00 00 02 95 30 39 01 00 00 11 00 03 f0 a5 a5 15 01 00 00 00 00 02 53 f8 39 01 00 00 11 00 03 51 0f ff];
							mi,mdss-dsi-hbm-off-command = [39 00 00 00 00 00 03 f0 5a 5a 39 00 00 00 00 00 02 b0 02 39 00 00 00 00 00 02 b5 53 39 01 00 00 00 00 03 f0 a5 a5 39 01 00 00 00 00 03 51 03 ff 39 00 00 00 00 00 03 f0 5a 5a 39 00 00 00 00 00 02 c7 23 39 00 00 00 00 00 02 b0 34 39 00 00 00 00 00 02 b1 5d 39 00 00 00 00 00 02 b0 06 39 00 00 00 00 00 20 b1 30 00 00 16 0f 85 08 29 52 7b cd 9a 65 ff 00 00 01 12 23 30 08 29 52 7b cd 1f 9a 15 90 0a 85 39 00 00 00 00 00 02 b0 03 39 00 00 00 00 00 1b b5 50 50 50 50 50 50 50 50 50 50 50 50 50 50 50 50 50 50 50 50 50 50 50 50 50 50 39 00 00 00 00 00 02 b0 17 39 00 00 00 00 00 02 95 00 39 01 00 00 00 00 03 f0 a5 a5 15 01 00 00 00 00 02 53 38];
							mi,mdss-dsi-hbm-on-command-state = "dsi_hs_mode";
							mi,mdss-dsi-hbm-off-command-state = "dsi_hs_mode";
							mi,mdss-dsi-hbm-fod-on-command = [39 00 00 00 00 00 03 f0 5a 5a 39 00 00 00 00 00 02 b0 02 39 00 00 00 00 00 02 b5 93 39 01 00 00 00 00 03 f0 a5 a5 15 01 00 00 0c 00 02 53 f0 39 00 00 00 00 00 03 51 0d ff 39 00 00 00 00 00 03 f0 5a 5a 39 00 00 00 00 00 02 c7 27 39 00 00 00 00 00 02 b0 34 39 00 00 00 00 00 02 b1 4b 39 00 00 00 00 00 02 b0 06 39 00 00 00 00 00 20 b1 00 00 00 0f 03 e1 02 0a 14 1e 33 66 00 ff 00 00 00 00 00 00 02 0a 14 1e 33 47 66 85 a4 c2 e1 39 00 00 00 00 00 02 b0 03 39 00 00 00 00 00 1b b5 14 14 14 14 14 14 14 14 14 14 14 14 14 14 14 14 14 14 14 14 14 14 14 14 14 14 39 00 00 00 00 00 02 b0 17 39 00 00 00 00 00 02 95 30 39 01 00 00 00 00 03 f0 a5 a5];
							mi,mdss-dsi-hbm-fod-off-command = [39 00 00 00 00 00 03 f0 5a 5a 39 00 00 00 00 00 02 b0 02 39 00 00 00 00 00 02 b5 13 39 01 00 00 00 00 03 f0 a5 a5 15 00 00 00 00 00 02 53 30 39 01 00 00 00 00 03 51 03 ff 39 00 00 00 00 00 03 f0 5a 5a 39 00 00 00 00 00 02 c7 23 39 00 00 00 00 00 02 b0 34 39 00 00 00 00 00 02 b1 5d 39 00 00 00 00 00 02 b0 06 39 00 00 00 00 00 20 b1 30 00 00 16 0f 85 08 29 52 7b cd 9a 65 ff 00 00 01 12 23 30 08 29 52 7b cd 1f 9a 15 90 0a 85 39 00 00 00 00 00 02 b0 03 39 00 00 00 00 00 1b b5 50 50 50 50 50 50 50 50 50 50 50 50 50 50 50 50 50 50 50 50 50 50 50 50 50 50 39 00 00 00 00 00 02 b0 17 39 00 00 00 00 00 02 95 00 39 01 00 00 00 00 03 f0 a5 a5];
							mi,mdss-dsi-hbm-fod-on-command-state = "dsi_hs_mode";
							mi,mdss-dsi-hbm-fod-off-command-state = "dsi_hs_mode";
							mi,mdss-dsi-flat-on-command = [39 00 00 00 00 00 03 f0 5a 5a 39 00 00 00 00 00 1d 95 2e 2d 09 09 09 24 24 24 30 30 30 39 39 39 3c 3c 3c 3d 42 7c c7 55 c0 43 1b e0 2f 48 39 00 00 00 00 00 02 f7 06 39 01 00 00 00 00 03 f0 a5 a5];
							mi,mdss-dsi-flat-off-command = [39 00 00 00 00 00 03 f0 5a 5a 39 00 00 00 00 00 1d 95 2e 0d 09 09 09 24 24 24 30 30 30 39 39 39 3c 3c 3c 3d 42 7c c7 55 c0 43 1b e0 2f 48 39 00 00 00 00 00 02 f7 06 39 01 00 00 00 00 03 f0 a5 a5];
							mi,mdss-dsi-flat-on-command-state = "dsi_hs_mode";
							mi,mdss-dsi-flat-off-command-state = "dsi_hs_mode";
							mi,mdss-dsi-hbm-hdr-on-command = [39 00 00 00 00 00 03 f0 5a 5a 39 00 00 00 00 00 02 b0 02 39 00 00 00 00 00 02 b5 53 39 00 00 00 00 00 02 c7 27 39 00 00 00 00 00 02 b0 34 39 00 00 00 00 00 02 b1 4b 39 00 00 00 00 00 02 b0 06 39 00 00 00 00 00 20 b1 00 00 00 0f 03 e1 02 0a 14 1e 33 66 00 ff 00 00 00 00 00 00 02 0a 14 1e 33 47 66 85 a4 c2 e1 39 00 00 00 00 00 02 b0 03 39 00 00 00 00 00 1b b5 14 14 14 14 14 14 14 14 14 14 14 14 14 14 14 14 14 14 14 14 14 14 14 14 14 14 39 00 00 00 00 00 02 b0 17 39 00 00 00 00 00 02 95 30 39 01 00 00 11 00 03 f0 a5 a5 15 01 00 00 00 00 02 53 f8 39 01 00 00 11 00 03 51 0f ff];
							mi,mdss-dsi-hbm-hdr-off-command = [39 00 00 00 00 00 03 f0 5a 5a 39 00 00 00 00 00 02 b0 02 39 00 00 00 00 00 02 b5 53 39 01 00 00 00 00 03 f0 a5 a5 39 01 00 00 00 00 03 51 03 ff 39 00 00 00 00 00 03 f0 5a 5a 39 00 00 00 00 00 02 c7 23 39 00 00 00 00 00 02 b0 34 39 00 00 00 00 00 02 b1 5d 39 00 00 00 00 00 02 b0 06 39 00 00 00 00 00 20 b1 30 00 00 16 0f 85 08 29 52 7b cd 9a 65 ff 00 00 01 12 23 30 08 29 52 7b cd 1f 9a 15 90 0a 85 39 00 00 00 00 00 02 b0 03 39 00 00 00 00 00 1b b5 50 50 50 50 50 50 50 50 50 50 50 50 50 50 50 50 50 50 50 50 50 50 50 50 50 50 39 00 00 00 00 00 02 b0 17 39 00 00 00 00 00 02 95 00 39 01 00 00 00 00 03 f0 a5 a5 15 01 00 00 00 00 02 53 38];
							mi,mdss-dsi-hbm-hdr-on-command-state = "dsi_hs_mode";
							mi,mdss-dsi-hbm-hdr-off-command-state = "dsi_hs_mode";
							mi,mdss-dsi-dimmingon-command = [15 01 00 00 00 00 02 53 38];
							mi,mdss-dsi-dimmingon-command-state = "dsi_hs_mode";
							mi,mdss-dsi-dimmingoff-command = [15 01 00 00 00 00 02 53 30];
							mi,mdss-dsi-dimmingoff-command-state = "dsi_hs_mode";
							mi,mdss-dsi-level2-key-enable-command = [39 01 00 00 00 00 03 f0 5a 5a];
							mi,mdss-dsi-gamma-otp-read-c8-command = [06 01 00 00 00 00 02 c8 00];
							mi,mdss-dsi-gamma-otp-read-c9-command = [06 01 00 00 00 00 02 c9 00];
							mi,mdss-dsi-gamma-otp-read-b3-pre-command = [15 01 00 00 00 00 02 b0 02];
							mi,mdss-dsi-gamma-otp-read-b3-command = [06 01 00 00 00 00 02 b3 00];
							mi,mdss-dsi-level2-key-disable-command = [39 01 00 00 00 00 03 f0 a5 a5];
							mi,mdss-dsi-gamma-flash-read-pre-command = <0x39000000 0x3f0 0x5a5a3900 0x0 0x3f1f1a2 0x39000000 0xdc1 0x6 0x0 0x5 0x15000000 0x2c0 0x3390000 0xc 0xc1000000 0x1400200 0x10 0x15000000 0x2c0 0x3390000 0xe 0xc1000000 0x6b000000 0xa000000 0x5011500 0x0 0x2b00739 0x0 0x4c107 0x1500 0x0 0x2c00315 0x1000000 0x2b00b>;
							mi,mdss-dsi-gamma-read-fb-command = [06 01 00 00 00 00 02 fb 00];
							mi,mdss-dsi-level2-key-enable-command-state = "dsi_lp_mode";
							mi,mdss-dsi-gamma-otp-read-c8-command-state = "dsi_lp_mode";
							mi,mdss-dsi-gamma-otp-read-c9-command-state = "dsi_lp_mode";
							mi,mdss-dsi-gamma-otp-read-b3-pre-command-state = "dsi_lp_mode";
							mi,mdss-dsi-gamma-otp-read-b3-command-state = "dsi_lp_mode";
							mi,mdss-dsi-level2-key-disable-command-state = "dsi_lp_mode";
							mi,mdss-dsi-gamma-flash-read-pre-command-state = "dsi_lp_mode";
							mi,mdss-dsi-gamma-read-fb-command-state = "dsi_lp_mode";
							mi,mdss-dsi-white-point-read-command = [06 01 00 00 01 00 02 a1 00];
							mi,mdss-dsi-white-point-read-command-state = "dsi_lp_mode";
							mi,mdss-dsi-crc-off-command = [39 01 00 00 00 00 02 81 00 39 00 00 00 00 00 03 f0 5a 5a 39 00 00 00 00 00 02 67 01 39 01 00 00 00 00 03 f0 a5 a5];
							mi,mdss-dsi-crc-off-command-state = "dsi_hs_mode";
							mi,mdss-dsi-black-setting-command = [39 00 00 00 00 00 03 f0 5a 5a 39 00 00 00 00 00 03 b0 29 b3 39 00 00 00 00 00 04 b3 00 00 00 39 00 00 00 00 00 03 b0 2e bb 39 00 00 00 00 00 04 bb 00 00 00 39 00 00 00 00 00 03 b0 25 b1 39 00 00 00 00 00 10 b1 98 88 76 54 32 04 dc 6a 0d 42 95 30 6a 3e 2a 39 01 00 00 00 00 03 f0 a5 a5];
							mi,mdss-dsi-black-setting-command-state = "dsi_hs_mode";
							qcom,mdss-dsi-panel-phy-timings = [00 18 06 06 21 20 06 06 04 02 04 00 15 16];
							qcom,display-topology = <0x1 0x1 0x1>;
							qcom,default-topology-index = <0x0>;
						};
					};
				};

/*
 * cmi 触摸：st,fts @ i2c@a94000, 地址 0x49
 *
 * 来源：目标设备 /sys/firmware/fdt，经 tools/fdt2dts.py 转换。
 * reset = GPIO 38、irq = GPIO 39、vdd/avdd 供电、固件 st_fts_j1.ftb。
 *
 * 待接入：需要 sm8250.dtsi 先提供 i2c_a94000 与 tlmm 节点。
 */

				fts@49 {
					status = "ok";
					compatible = "st,fts";
					reg = <0x49>;
					interrupt-parent = <0x65>;
					interrupts = <0x27 0x2008>;
					pinctrl-names = "pmx_ts_active", "pmx_ts_suspend";
					pinctrl-0 = <0x40c>;
					pinctrl-1 = <0x40d 0x40e>;
					avdd-supply = <0x6f1>;
					vdd-supply = <0x38d>;
					fts,pwr-reg-name = "avdd";
					fts,bus-reg-name = "vdd";
					fts,irq-gpio = <0x65 0x27 0x2008>;
					fts,irq-gpio-name = "fts_irq";
					fts,reset-gpio-enable;
					fts,reset-gpio = <0x65 0x26 0x0>;
					fts,reset-gpio-name = "fts_rst";
					fts,irq-flags = <0x2008>;
					fts,x-max = <0x438>;
					fts,y-max = <0x924>;
					fts,fod-lx = <0x1a5>;
					fts,fod-ly = <0x6fc>;
					fts,fod-x-size = <0xee>;
					fts,fod-y-size = <0xee>;
					fts,default-fw-name = "st_fts_j1.ftb";
					fts,config-array-size = <0x1>;
					fts,dump-click-count;
					fts,support-fod;
					fts,touch-up-threshold-min = <0x28>;
					fts,touch-up-threshold-max = <0x78>;
					fts,touch-up-threshold-def = <0x50>;
					fts,touch-tolerance-min = <0x5>;
					fts,touch-tolerance-max = <0x23>;
					fts,touch-tolerance-def = <0x19>;
					fts,touch-idletime-min = <0x0>;
					fts,touch-idletime-max = <0x31ce>;
					fts,touch-idletime-def = <0x30a2>;
					fts,cornerfilter-area-step1 = <0x64>;
					fts,cornerfilter-area-step2 = <0xaa>;
					fts,cornerfilter-area-step3 = <0xfa>;
					fts,touch-deadzone-filter-ver = <0x2 0x0 0x0 0x0 0x0 0x0 0x0 0x0 0x2 0x1 0x0 0x0 0x0 0x0 0x0 0x0 0x2 0x2 0x0 0x0 0x5 0x923 0x0 0x0 0x2 0x3 0x432 0x0 0x437 0x923 0x0 0x0>;
					fts,touch-deadzone-filter-hor = <0x2 0x0 0x0 0x0 0x437 0x5 0x0 0x0 0x2 0x1 0x0 0x91e 0x437 0x923 0x0 0x0 0x2 0x2 0x0 0x0 0x5 0x923 0x0 0x0 0x2 0x3 0x432 0x0 0x437 0x923 0x0 0x0>;
					fts,touch-edgezone-filter-ver = <0x1 0x0 0x0 0x0 0x0 0x0 0x0 0x0 0x1 0x1 0x0 0x0 0x0 0x0 0x0 0x0 0x1 0x2 0x0 0x0 0x28 0x923 0x0 0x0 0x1 0x3 0x40f 0x0 0x437 0x923 0x0 0x0>;
					fts,touch-edgezone-filter-hor = <0x1 0x0 0x0 0x0 0x437 0x28 0x0 0x0 0x1 0x1 0x0 0x8fb 0x437 0x923 0x0 0x0 0x1 0x2 0x0 0x0 0x28 0x923 0x0 0x0 0x1 0x3 0x40f 0x0 0x437 0x923 0x0 0x0>;
					fts,touch-cornerzone-filter-ver = <0x0 0x0 0x0 0x0 0x0 0x0 0x0 0x0 0x0 0x1 0x0 0x0 0x0 0x0 0x0 0x0 0x0 0x2 0x0 0x7f7 0x96 0x923 0x0 0x0 0x0 0x3 0x3a1 0x7f7 0x437 0x923 0x0 0x0>;
					fts,touch-cornerzone-filter-hor1 = <0x0 0x0 0x0 0x0 0xaa 0xaa 0x0 0x0 0x0 0x1 0x0 0x0 0x0 0x0 0x0 0x0 0x0 0x2 0x0 0x879 0xaa 0x923 0x0 0x0 0x0 0x3 0x0 0x0 0x0 0x0 0x0 0x0>;
					fts,touch-cornerzone-filter-hor2 = <0x0 0x0 0x0 0x0 0x0 0x0 0x0 0x0 0x0 0x1 0x38d 0x0 0x437 0xaa 0x0 0x0 0x0 0x2 0x0 0x0 0x0 0x0 0x0 0x0 0x0 0x3 0x38d 0x879 0x437 0x923 0x0 0x0>;
					fts,cfg_0 {
						fts,tp-vendor = <0x38>;
						fts,fw-name = "st_fts_j1.ftb";
						fts,limit-name = "stm_fts_production_limits.csv";
					};
				};
